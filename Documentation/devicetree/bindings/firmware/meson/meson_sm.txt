## Documentation/devicetree/bindings/firmware/meson/meson_sm.txt
```
* Amlogic Secure Monitor

In the Amlogic SoCs the Secure Monitor code is used to provide access to the
NVMEM, enable JTAG, set USB boot, etc...

Required properties for the secure monitor node:
- compatible: Should be "amlogic,meson-sm"
- amlogic,sm-cmd-input-base: SMC32 function identifier to read the physical
                             address of the input buffer
- amlogic,sm-cmd-output-base: SMC32 function identifier to read the physical
                              address of the output buffer

Example:

	#include <dt-bindings/firmware/meson-gxbb-sm.h>

	...

	firmware {
		compatible = "simple-bus";

		secure-monitor {
			compatible = "amlogic,meson-sm";
			amlogic,sm-cmd-input-base = <SM_GET_SHARE_MEM_INPUT_BASE>;
			amlogic,sm-cmd-output-base = <SM_GET_SHARE_MEM_OUTPUT_BASE>;
		};
	};

Node of a device using the secure monitor must have a custom property to
specify the SMC32 function the driver is going to use. The values of all the
SMC function identifiers are listed in a SoC-specific header file:

"include/dt-bindings/firmware/meson-gxbb-sm.h" - for the Meson GXBB secure monitor.

Example of the node using the secure monitor:

	#include <dt-bindings/firmware/meson-gxbb-sm.h>

	...

	efuse: efuse {
		compatible = "amlogic,meson-gxbb-efuse";
		amlogic,sm-cmd-read-efuse = <SM_EFUSE_READ>;
		#address-cells = <1>;
		#size-cells = <1>;

		...
	};
```

## Documentation/devicetree/bindings/mmc/meson-mmc.txt
```
* Amlogic Meson MMC controller

The highspeed MMC host controller on Amlogic SoCs provides an interface
for MMC, SD, SDIO and SDHC types of memory cards.

Supported maximum speeds are the ones of the eMMC standard 4.41 as well
as the speed of SD standard 2.0.

Required properties:
 - compatible : "amlogic,meson-mmc"
 - reg : mmc controller base registers
 - interrupts : mmc controller interrupt
 - clocks : phandle to clock provider
 - pinctrl-names : should contain "sdio_a" or "sdio_b"
 - pinctrl-0: Should specify pin control groups used for this controller

Optional properties:
 - meson,sd-port : 0 for port A, 1 for port B
 - for cd, bus-width and additional generic mmc parameters
   please refer to mmc.txt within this directory

Examples:
	mmc0: mmc@c1108c20 {
		pinctrl-names = "sdio_b";
		pinctrl-0 = <&mmc0_sd_b_pins>;
		compatible = "amlogic,meson-mmc";
		reg = <0xc1108c20 0x20>;
		interrupts = <0 28 1>;
		clocks = <&clkc CLKID_CLK81>;
	};
```

## Documentation/devicetree/bindings/reset/amlogic,meson6-rst-mgr-ao.txt
```
Amlogic MesonX Reset Manager (AO domain)

Required properties:
- compatible : "amlogic,meson6-rst-mgr-ao"
- reg : Should contain 1 register ranges(address and length)
- #reset-cells: 1

Example:

	reset: reset@c8100040 {
		#reset-cells = <1>;
		compatible = "amlogic,meson6-rst-mgr-ao";
		reg = <0xc8100040 0x4>;
	};
```

## drivers/firmware/meson/Kconfig
```kconfig
#
# Amlogic Secure Monitor driver
#
config MESON_SM
	bool
	default ARCH_MESON
	help
	  Say y here to enable the Amlogic secure monitor driver
```
